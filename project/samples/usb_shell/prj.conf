## CMakeLists.txt
```
cmake_minimum_required(VERSION 3.20.0)
find_package(Zephyr REQUIRED HINTS $ENV{ZEPHYR_BASE})
project(usb_shell)

target_sources(app PRIVATE src/main.c)
```

## prj.conf
```kconfig
# USB device stack
CONFIG_USB_DEVICE_STACK=y
CONFIG_USB_DEVICE_PRODUCT="Tracker Shell"
CONFIG_USB_DEVICE_VID=0x2FE3
CONFIG_USB_DEVICE_PID=0x0001

# CDC ACM as console
CONFIG_SERIAL=y
CONFIG_CONSOLE=y
CONFIG_UART_CONSOLE=y
CONFIG_UART_LINE_CTRL=y

# Shell over USB serial
CONFIG_SHELL=y
CONFIG_SHELL_BACKEND_SERIAL=y

# Logging
CONFIG_LOG=y

# GPIO
CONFIG_GPIO=y
CONFIG_GPIO_SHELL=y

# I2C + shell
CONFIG_I2C=y
CONFIG_I2C_SHELL=y

# SPI + shell
CONFIG_SPI=y
CONFIG_SPI_SHELL=y

# Sensors
CONFIG_SENSOR=y
CONFIG_SENSOR_SHELL=y
CONFIG_LSM6DSO=y
CONFIG_LIS3MDL=y
CONFIG_LIS3MDL_TRIGGER_NONE=y

# Power domains (3V3 + 5V rails)
CONFIG_PM_DEVICE=y
CONFIG_PM_DEVICE_RUNTIME=y
CONFIG_PM_DEVICE_POWER_DOMAIN=y
CONFIG_PM_DEVICE_SHELL=y
CONFIG_TIMEOUT_64BIT=y
CONFIG_POWER_DOMAIN=y
CONFIG_POWER_DOMAIN_GPIO_INIT_PRIORITY=1

# Device shell (list/inspect devices)
CONFIG_DEVICE_SHELL=y
```

## boards/tracker_stm32u575xx.overlay
```dts
/*
 * Route the Zephyr console/shell to USB CDC ACM on the Tracker board.
 */

&zephyr_udc0 {
	cdc_acm_uart0: cdc_acm_uart0 {
		compatible = "zephyr,cdc-acm-uart";
	};
};

/ {
	chosen {
		zephyr,console = &cdc_acm_uart0;
		zephyr,shell-uart = &cdc_acm_uart0;
	};
};
```

## src/main.c
```c
/*
 * USB Shell — Zephyr interactive shell over USB CDC ACM.
 *
 * Powers on the 3V3 and 5V domains so all peripherals are accessible
 * from the shell (i2c, spi, sensor, gpio, device commands).
 *
 * SPDX-License-Identifier: Apache-2.0
 */

#include <zephyr/kernel.h>
#include <zephyr/device.h>
#include <zephyr/drivers/uart.h>
#include <zephyr/usb/usb_device.h>
#include <zephyr/pm/device_runtime.h>
#include <zephyr/logging/log.h>

LOG_MODULE_REGISTER(usb_shell, LOG_LEVEL_INF);

int main(void)
{
	const struct device *usb_dev = DEVICE_DT_GET_ONE(zephyr_cdc_acm_uart);

	if (!device_is_ready(usb_dev)) {
		LOG_ERR("CDC ACM device not ready");
		return -1;
	}

	int ret = usb_enable(NULL);
	if (ret) {
		LOG_ERR("Failed to enable USB (%d)", ret);
		return ret;
	}

	/* Power on both rails */
	pm_device_runtime_get(DEVICE_DT_GET(DT_NODELABEL(power_3v3)));
	pm_device_runtime_get(DEVICE_DT_GET(DT_NODELABEL(power_5v)));

	/* Wait for host to open the port (DTR set). */
	uint32_t dtr = 0;
	while (!dtr) {
		uart_line_ctrl_get(usb_dev, UART_LINE_CTRL_DTR, &dtr);
		k_sleep(K_MSEC(100));
	}

	LOG_INF("USB shell ready — type 'help' for commands");
	LOG_INF("Try: device list, i2c scan, sensor get, gpio");

	return 0;
}
```
