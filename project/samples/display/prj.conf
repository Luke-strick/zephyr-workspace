## CMakeLists.txt
```
cmake_minimum_required(VERSION 3.20.0)

# Register display_ui as a Zephyr extra module so its Kconfig symbols
# and CMake library are picked up automatically.
list(APPEND ZEPHYR_EXTRA_MODULES
  ${CMAKE_CURRENT_SOURCE_DIR}/../../lib/display_ui
)

find_package(Zephyr REQUIRED HINTS $ENV{ZEPHYR_BASE})
project(display_sample)

target_sources(app PRIVATE src/main.c)
```

## prj.conf
```kconfig
# Console over RTT (STLink v2 / OpenOCD)
CONFIG_LOG=y
CONFIG_LOG_BACKEND_RTT=y
CONFIG_LOG_BACKEND_UART=n
CONFIG_USE_SEGGER_RTT=y
CONFIG_CONSOLE=y
CONFIG_RTT_CONSOLE=y
CONFIG_UART_CONSOLE=n

# Display
CONFIG_DISPLAY=y
CONFIG_SPI=y
CONFIG_GPIO=y

# Display UI library (Sharp LS027B7DH01A defaults)
CONFIG_DISPLAY_UI=y
CONFIG_DISPLAY_UI_FB_W=400
CONFIG_DISPLAY_UI_FB_H=240
CONFIG_DISPLAY_UI_PORTRAIT=y
CONFIG_DISPLAY_UI_ROWS=3

# Menu screen
CONFIG_DISPLAY_UI_MENU_TITLE_H=50
CONFIG_DISPLAY_UI_MENU_ITEM_MIN_H=60
CONFIG_DISPLAY_UI_MENU_BORDER_T=2
CONFIG_DISPLAY_UI_MENU_TEXT_SCALE=2

# Power domains (3V3 + 5V rails)
CONFIG_PM_DEVICE=y
CONFIG_PM_DEVICE_RUNTIME=y
CONFIG_PM_DEVICE_POWER_DOMAIN=y
CONFIG_TIMEOUT_64BIT=y
CONFIG_POWER_DOMAIN=y
CONFIG_POWER_DOMAIN_GPIO_INIT_PRIORITY=1
```

## boards/tracker_stm32u575xx.overlay
```dts
/*
 * Route console/log output to USB CDC ACM on the Tracker board.
 */

&zephyr_udc0 {
	cdc_acm_uart0: cdc_acm_uart0 {
		compatible = "zephyr,cdc-acm-uart";
	};
};

/ {
	chosen {
		zephyr,console = &cdc_acm_uart0;
		zephyr,shell-uart = &cdc_acm_uart0;
	};
};
```

## src/main.c
```c
/*
 * Display sample — menu / options screen demo
 *
 * Button 1 (sw0): scroll to next item
 * Button 2 (sw1): activate selected item (run action or enter submenu)
 *
 * Menu structure:
 *   SETTINGS
 *     DISPLAY  →  DISPLAY
 *                   INVERT SPD  (action)
 *                   BACK        →  SETTINGS
 *     SENSORS  →  SENSORS
 *                   CALIBRATE   (action stub)
 *                   BACK        →  SETTINGS
 *
 * SPDX-License-Identifier: Apache-2.0
 */

#include <zephyr/kernel.h>
#include <zephyr/device.h>
#include <zephyr/drivers/gpio.h>
#include <zephyr/pm/device_runtime.h>
#include <display_ui.h>

/* ── Buttons ─────────────────────────────────────────────────────────────── */

static const struct gpio_dt_spec btn_scroll =
	GPIO_DT_SPEC_GET(DT_ALIAS(sw0), gpios);
static const struct gpio_dt_spec btn_select =
	GPIO_DT_SPEC_GET(DT_ALIAS(sw1), gpios);

/* ── Action callbacks ────────────────────────────────────────────────────── */

static bool speed_inverted;

static void action_invert_speed(void)
{
	speed_inverted = !speed_inverted;
	printk("Speed row inverted: %s\n", speed_inverted ? "on" : "off");
}

static void action_calibrate(void)
{
	printk("Calibrate stub — not implemented\n");
}

/* ── Menu descriptors ────────────────────────────────────────────────────── */

/* Forward declarations so submenu callbacks can reference later menus. */
static const display_ui_menu_t menu_main;
static const display_ui_menu_t menu_display;
static const display_ui_menu_t menu_sensors;

static const display_ui_menu_t *go_main(void)    { return &menu_main; }
static const display_ui_menu_t *go_display(void) { return &menu_display; }
static const display_ui_menu_t *go_sensors(void) { return &menu_sensors; }

static const display_ui_menu_item_t items_main[] = {
	DISPLAY_UI_SUBMENU_ITEM("DISPLAY", go_display),
	DISPLAY_UI_SUBMENU_ITEM("SENSORS", go_sensors),
};

static const display_ui_menu_t menu_main = {
	.title = "SETTINGS",
	.items = items_main,
	.count = ARRAY_SIZE(items_main),
};

static const display_ui_menu_item_t items_display[] = {
	DISPLAY_UI_ACTION_ITEM("INVERT SPD", action_invert_speed),
	DISPLAY_UI_SUBMENU_ITEM("BACK",      go_main),
};

static const display_ui_menu_t menu_display = {
	.title = "DISPLAY",
	.items = items_display,
	.count = ARRAY_SIZE(items_display),
};

static const display_ui_menu_item_t items_sensors[] = {
	DISPLAY_UI_ACTION_ITEM("CALIBRATE", action_calibrate),
	DISPLAY_UI_SUBMENU_ITEM("BACK",     go_main),
};

static const display_ui_menu_t menu_sensors = {
	.title = "SENSORS",
	.items = items_sensors,
	.count = ARRAY_SIZE(items_sensors),
};

/* ── Main ────────────────────────────────────────────────────────────────── */

int main(void)
{
	pm_device_runtime_get(DEVICE_DT_GET(DT_NODELABEL(power_3v3)));
	pm_device_runtime_get(DEVICE_DT_GET(DT_NODELABEL(power_5v)));

	const struct device *disp = DEVICE_DT_GET(DT_CHOSEN(zephyr_display));

	if (display_ui_init(disp) < 0) {
		printk("Display not ready\n");
		return -ENODEV;
	}

	gpio_pin_configure_dt(&btn_scroll, GPIO_INPUT);
	gpio_pin_configure_dt(&btn_select, GPIO_INPUT);

	const display_ui_menu_t *menu = &menu_main;
	int selected = 0;

	display_ui_draw_menu(menu, selected);
	display_ui_flush();

	bool prev_scroll = false;
	bool prev_select = false;

	while (1) {
		/* Active-low buttons: pressed = 0 */
		bool scroll = gpio_pin_get_dt(&btn_scroll) == 0;
		bool select = gpio_pin_get_dt(&btn_select) == 0;

		if (scroll && !prev_scroll) {
			selected = (selected + 1) % menu->count;
			display_ui_draw_menu(menu, selected);
			display_ui_flush();
		}

		if (select && !prev_select) {
			menu = display_ui_menu_activate(menu, selected);
			selected = 0;
			display_ui_draw_menu(menu, selected);
			display_ui_flush();
		}

		prev_scroll = scroll;
		prev_select = select;

		k_msleep(50);
	}

	return 0;
}
```
