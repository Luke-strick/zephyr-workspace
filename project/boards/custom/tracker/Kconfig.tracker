## project/boards/custom/tracker/Kconfig.tracker
```kconfig
# SPDX-License-Identifier: Apache-2.0

config BOARD_TRACKER
	select SOC_STM32U575XX
```

## project/boards/custom/tracker/board.yml
```yaml
board:
  name: tracker
  full_name: Custom GPS/LoRa Tracker
  vendor: custom
  socs:
    - name: stm32u575xx
```

## project/boards/custom/tracker/tracker_defconfig
```kconfig
# SPDX-License-Identifier: Apache-2.0

# Core
CONFIG_GPIO=y
CONFIG_SERIAL=y
CONFIG_CONSOLE=y
CONFIG_UART_CONSOLE=y
CONFIG_PINCTRL=y

# Bus
CONFIG_SPI=y
CONFIG_I2C=y

# Security
CONFIG_ARM_MPU=y
CONFIG_HW_STACK_PROTECTION=y

# Clock
CONFIG_CLOCK_CONTROL=y
```

## project/lib/ahrs/Kconfig
```kconfig
config AHRS
	bool "AHRS library (tilt-compensated compass)"
	depends on SENSOR
	select FPU
	help
	  Attitude and Heading Reference System combining an LSM6DSO
	  accel/gyro with a LIS3MDL magnetometer. Provides roll, pitch,
	  and tilt-compensated magnetic heading via a complementary filter.

if AHRS

config AHRS_ALPHA_X1000
	int "Complementary filter alpha (× 1000)"
	default 960
	range 0 999
	help
	  Gyro trust factor for the complementary filter, scaled by 1000.
	  960 means alpha = 0.96.  Higher values trust the gyro more
	  (smoother but slower to correct drift).

config AHRS_DT_MS
	int "Filter sample period in milliseconds"
	default 50
	help
	  Expected time between ahrs_update() calls.  Should match the
	  rate at which the application calls the function (default 20 Hz).

config AHRS_GYRO_DEADBAND_MRAD
	int "Gyro deadband in milli-radians per second"
	default 1
	help
	  Gyro readings below this magnitude (after bias removal) are
	  clamped to zero to prevent yaw drift accumulation.

endif # AHRS
```

## project/lib/display_ui/Kconfig
```kconfig
config DISPLAY_UI
	bool "Display UI library"
	depends on DISPLAY
	help
	  Framebuffer-based UI library for 1bpp displays. Provides
	  large 7-segment digit rows with optional postfixes and labels.

if DISPLAY_UI

config DISPLAY_UI_FB_W
	int "Physical display width in pixels"
	default 400
	help
	  Width of the display as reported by the driver (landscape axis).

config DISPLAY_UI_FB_H
	int "Physical display height in pixels"
	default 240
	help
	  Height of the display as reported by the driver (landscape axis).

config DISPLAY_UI_PORTRAIT
	bool "Portrait orientation (90 degree CCW software rotation)"
	default y
	help
	  When enabled the virtual canvas is rotated so that FB_W becomes
	  the tall axis. Useful for landscape-wired displays mounted upright.

config DISPLAY_UI_ROWS
	int "Number of digit rows"
	default 3
	range 1 8

config DISPLAY_UI_DIGIT_T
	int "7-segment stroke thickness in virtual pixels"
	default 10

config DISPLAY_UI_COL_GAP
	int "Pixel gap between digits within a row"
	default 8

config DISPLAY_UI_ROW_INSET
	int "Segment endpoint inset to avoid corner bleed"
	default 2

config DISPLAY_UI_NUMBER_SHIFT
	int "Left shift of digit block to make room for postfix (pixels)"
	default 14

config DISPLAY_UI_LABEL_SCALE
	int "Font scale multiplier for row labels"
	default 2
	range 1 8

endif # DISPLAY_UI
```
