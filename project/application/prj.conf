## CMakeLists.txt
```
cmake_minimum_required(VERSION 3.20.0)

list(APPEND ZEPHYR_EXTRA_MODULES
  ${CMAKE_CURRENT_SOURCE_DIR}/../lib/display_ui
  ${CMAKE_CURRENT_SOURCE_DIR}/../lib/ahrs
  ${CMAKE_CURRENT_SOURCE_DIR}/../lib/nav
)

find_package(Zephyr REQUIRED HINTS $ENV{ZEPHYR_BASE})
project(tracker_app)

target_sources(app PRIVATE
  src/main.c
  src/config.c
  src/data_engine.c
  src/data_processor.c
  src/lora_comms.c
  src/display_engine.c
)

target_include_directories(app PRIVATE src)
```

## prj.conf
```kconfig
# ── Console (RTT via STLink) ──────────────────────────────────────────────
CONFIG_LOG=y
CONFIG_LOG_BACKEND_RTT=y
CONFIG_LOG_BACKEND_UART=n
CONFIG_USE_SEGGER_RTT=y
CONFIG_CONSOLE=y
CONFIG_RTT_CONSOLE=y
CONFIG_UART_CONSOLE=n

# ── Core peripherals ──────────────────────────────────────────────────────
CONFIG_GPIO=y
CONFIG_SERIAL=y
CONFIG_SENSOR=y
CONFIG_I2C=y
CONFIG_SPI=y
CONFIG_DISPLAY=y

# ── Sensors ───────────────────────────────────────────────────────────────
CONFIG_LSM6DSO=y
CONFIG_LSM6DSO_TRIGGER_NONE=y
CONFIG_LIS3MDL=y
CONFIG_LIS3MDL_TRIGGER_NONE=y
CONFIG_LIS3MDL_ODR="20"

# ── GNSS ──────────────────────────────────────────────────────────────────
CONFIG_GNSS=y
CONFIG_GNSS_NMEA_GENERIC=y
CONFIG_MODEM_MODULES=y
CONFIG_UART_INTERRUPT_DRIVEN=y

# ── LoRa ──────────────────────────────────────────────────────────────────
CONFIG_LORA=y
CONFIG_LORA_SX126X=y

# ── AHRS library ──────────────────────────────────────────────────────────
CONFIG_AHRS=y
CONFIG_AHRS_DT_MS=100
CONFIG_AHRS_ALPHA_X1000=960

# ── Display UI library ────────────────────────────────────────────────────
CONFIG_DISPLAY_UI=y
CONFIG_DISPLAY_UI_FB_W=320
CONFIG_DISPLAY_UI_FB_H=240
CONFIG_DISPLAY_UI_PORTRAIT=n
CONFIG_DISPLAY_UI_ROWS=1
CONFIG_DISPLAY_UI_MENU_TITLE_H=50
CONFIG_DISPLAY_UI_MENU_ITEM_MIN_H=60
CONFIG_DISPLAY_UI_MENU_BORDER_T=2
CONFIG_DISPLAY_UI_MENU_TEXT_SCALE=2

# ── Nav library ───────────────────────────────────────────────────────────
CONFIG_NAV=y
CONFIG_NAV_TACK_DEADBAND_DEG=15

# ── Non-volatile settings (NVS flash backend) ─────────────────────────────
CONFIG_SETTINGS=y
CONFIG_SETTINGS_NVS=y
CONFIG_NVS=y
CONFIG_FLASH=y
CONFIG_FLASH_MAP=y
CONFIG_FLASH_PAGE_LAYOUT=y

# ── Power domains ─────────────────────────────────────────────────────────
CONFIG_PM_DEVICE=y
CONFIG_PM_DEVICE_RUNTIME=y
CONFIG_PM_DEVICE_POWER_DOMAIN=y
CONFIG_POWER_DOMAIN=y
CONFIG_POWER_DOMAIN_GPIO_INIT_PRIORITY=1
CONFIG_TIMEOUT_64BIT=y

# ── FPU and float formatting ──────────────────────────────────────────────
CONFIG_FPU=y
CONFIG_CBPRINTF_FP_SUPPORT=y

# ── Threading ─────────────────────────────────────────────────────────────
CONFIG_MAIN_STACK_SIZE=4096
CONFIG_HEAP_MEM_POOL_SIZE=4096
```

## src/main.c
```c
/*
 * Sailing Tracker — main application
 *
 * Initialisation order:
 *   1. Power domains (3V3 → sensors/LoRa/GPS, 5V → LCD)
 *   2. NVS settings + config
 *   3. AHRS (sensors)
 *   4. Nav library
 *   5. Data engine thread
 *   6. Data processor thread
 *   7. LoRa comms threads (if enabled)
 *   8. Display engine thread
 *
 * SPDX-License-Identifier: Apache-2.0
 */

#include "config.h"
#include "data_engine.h"
#include "data_processor.h"
#include "lora_comms.h"
#include "display_engine.h"

#include <ahrs.h>
#include <nav.h>

#include <zephyr/kernel.h>
#include <zephyr/device.h>
#include <zephyr/pm/device_runtime.h>
#include <zephyr/pm/device.h>
#include <zephyr/drivers/uart.h>
#include <zephyr/logging/log.h>

LOG_MODULE_REGISTER(main, LOG_LEVEL_INF);

/* ── UBX helpers ─────────────────────────────────────────────────────────── */

static const struct device *gps_uart = DEVICE_DT_GET(DT_NODELABEL(usart1));

static void ubx_send(uint8_t cls, uint8_t id,
		     const uint8_t *payload, uint16_t len)
{
	uint8_t ck_a = 0, ck_b = 0;

#define UBX_FEED(b)  do { uint8_t _b = (b); ck_a += _b; ck_b += ck_a; \
			   uart_poll_out(gps_uart, _b); } while (0)

	uart_poll_out(gps_uart, 0xB5);
	uart_poll_out(gps_uart, 0x62);

	UBX_FEED(cls);
	UBX_FEED(id);
	UBX_FEED((uint8_t)(len & 0xFF));
	UBX_FEED((uint8_t)(len >> 8));

	for (uint16_t i = 0; i < len; i++) {
		UBX_FEED(payload[i]);
	}

#undef UBX_FEED

	uart_poll_out(gps_uart, ck_a);
	uart_poll_out(gps_uart, ck_b);
}

static void ubx_enable_constellations(void)
{
	static const uint8_t payload[] = {
		0x00, 0x00, 0xFF, 0x03,
		/* GPS:     gnssId=0, resTrkCh=8,  maxTrkCh=16, L1C/A */
		0x00, 0x08, 0x10, 0x00,  0x01, 0x00, 0x01, 0x00,
		/* SBAS:    gnssId=1, resTrkCh=1,  maxTrkCh=3,  L1C/A */
		0x01, 0x01, 0x03, 0x00,  0x01, 0x00, 0x01, 0x00,
		/* GLONASS: gnssId=6, resTrkCh=8,  maxTrkCh=14, L1   */
		0x06, 0x08, 0x0E, 0x00,  0x01, 0x00, 0x01, 0x00,
	};

	ubx_send(0x06, 0x3E, payload, sizeof(payload));
}

/* ── Main ────────────────────────────────────────────────────────────────── */

int main(void)
{
	int ret;

	/* 1. Power up 3V3 domain (sensors, LoRa, GPS).
	 *    DTS startup-delay-us = 2000; pm_device_runtime_get waits for it. */
	ret = pm_device_runtime_get(DEVICE_DT_GET(DT_NODELABEL(power_3v3)));
	if (ret < 0) {
		LOG_ERR("Failed to enable 3V3 domain: %d", ret);
	}

	/* 2. Give the BN220 time to boot before sending UBX config. */
	k_msleep(200);

	/* 3. Enable GPS + SBAS + GLONASS on the M8030. */
	ubx_enable_constellations();

	/* 4. Resume the GNSS driver — starts suspended with CONFIG_PM_DEVICE=y.
	 *    pm_device_action_run (not runtime_get) because gnss_nmea_generic
	 *    calls pm_device_init_suspended, not pm_device_runtime_enable. */
	ret = pm_device_action_run(DEVICE_DT_GET(DT_NODELABEL(gnss)),
				   PM_DEVICE_ACTION_RESUME);
	if (ret < 0 && ret != -EALREADY) {
		LOG_ERR("GNSS resume failed: %d", ret);
	}

	/* 5. Power up 5V domain (LCD).
	 *    DTS startup-delay-us = 5000. */
	ret = pm_device_runtime_get(DEVICE_DT_GET(DT_NODELABEL(power_5v)));
	if (ret < 0) {
		LOG_ERR("Failed to enable 5V domain: %d", ret);
	}

	/* 6. Extra delay for SX1262 BUSY deassertion (~100 ms after power). */
	k_msleep(100);

	/* 7. Load config from NVS flash. */
	ret = config_init();
	if (ret < 0) {
		LOG_WRN("config_init failed (%d), continuing with defaults", ret);
	}

	const struct app_config *cfg = config_get();

	/* 8. Initialise AHRS with calibration values from config. */
	const struct device *imu = DEVICE_DT_GET(DT_NODELABEL(lsm6dso));
	const struct device *mag = DEVICE_DT_GET(DT_NODELABEL(lis3mdl));

	ret = ahrs_init(imu, mag);
	if (ret < 0) {
		LOG_ERR("ahrs_init failed: %d", ret);
	} else {
		ahrs_set_gyro_bias(cfg->gyro_bias_x_mdps,
				   cfg->gyro_bias_y_mdps,
				   cfg->gyro_bias_z_mdps);
		ahrs_set_mag_calibration(cfg->hard_iron,
					 (const float (*)[3])cfg->soft_iron);
	}

	/* 9. Initialise nav library. */
	nav_init();

	/* 10. Start data engine (spawns thread; GNSS callback registered statically). */
	ret = data_engine_init();
	if (ret < 0) {
		LOG_ERR("data_engine_init failed: %d", ret);
	}

	/* 11. Start data processor. */
	ret = data_processor_init();
	if (ret < 0) {
		LOG_ERR("data_processor_init failed: %d", ret);
	}

	/* 12. Start LoRa comms if enabled in config. */
	if (cfg->lora.enabled) {
		ret = lora_comms_init();
		if (ret < 0) {
			LOG_ERR("lora_comms_init failed: %d", ret);
		}
	} else {
		LOG_INF("LoRa disabled in config");
	}

	/* 13. Start display engine (last — benefits from fully initialised system). */
	ret = display_engine_init();
	if (ret < 0) {
		LOG_ERR("display_engine_init failed: %d", ret);
	}

	LOG_INF("Tracker started");

	config_set_sample_rate(DATA_RATE_10HZ);

	/* main() returns; all work is in spawned threads. */
	return 0;
}
```

## src/config.c
```c
/*
 * config — Application configuration store
 *
 * SPDX-License-Identifier: Apache-2.0
 */

#include "config.h"

#include <zephyr/settings/settings.h>
#include <zephyr/logging/log.h>
#include <string.h>

LOG_MODULE_REGISTER(config, LOG_LEVEL_INF);

/* ── Defaults ────────────────────────────────────────────────────────────── */


static const struct app_config cfg_defaults = {
	.sample_rate_hz = DATA_RATE_10HZ,
	.data_sources   = DATA_SRC_GPS | DATA_SRC_AHRS,
	.row_src        = ROW_SRC_ROLL_DEG,
	.box_src        = { BOX_SRC_SOG, BOX_SRC_COG, BOX_SRC_ROLL, BOX_SRC_TIMER },
	.timer_minutes  = 5,
	.lora = {
		.enabled    = false,
		.boat_id    = 0,
		.n_boats    = 1,
		.tx_rate_hz = 1,
		.frequency  = 915000000U,
		.tx_power   = 14,
	},
	.true_wind_dir_deg = 0.0f,
	.gyro_bias_x_mdps  = 288.0f,
	.gyro_bias_y_mdps  = -215.0f,
	.gyro_bias_z_mdps  = -599.0f,
	.hard_iron         = { -49.20f, 49.96f, -27.15f },
	.soft_iron         = {
		{ +1.0f, +0.0f, +0.0f },
		{ +0.0f, +1.0f, +0.0f },
		{ +0.0f, +0.0f, +1.0f },
	},
};

/* ── Live config ─────────────────────────────────────────────────────────── */

static struct app_config cfg;

/* ── Settings handler ────────────────────────────────────────────────────── */

static int h_set(const char *key, size_t len, settings_read_cb read_cb, void *cb_arg)
{
#define LOAD(k, field)							\
	if (strcmp(key, k) == 0) {					\
		if (len != sizeof(cfg.field)) { return -EINVAL; }	\
		read_cb(cb_arg, &cfg.field, len);			\
		return 0;						\
	}

	LOAD("engine/rate_hz",   sample_rate_hz)
	LOAD("engine/sources",   data_sources)
	LOAD("disp/stat",        row_src)
	LOAD("disp/boxes",       box_src)
	LOAD("disp/timer_min",   timer_minutes)
	LOAD("lora/enabled",     lora.enabled)
	LOAD("lora/boat_id",     lora.boat_id)
	LOAD("lora/n_boats",     lora.n_boats)
	LOAD("lora/tx_rate_hz",  lora.tx_rate_hz)
	LOAD("lora/frequency",   lora.frequency)
	LOAD("lora/tx_power",    lora.tx_power)
	LOAD("wind/twd",         true_wind_dir_deg)
	LOAD("cal/gyro_x",       gyro_bias_x_mdps)
	LOAD("cal/gyro_y",       gyro_bias_y_mdps)
	LOAD("cal/gyro_z",       gyro_bias_z_mdps)
	LOAD("cal/hard_iron",    hard_iron)
	LOAD("cal/soft_iron",    soft_iron)

#undef LOAD
	return -ENOENT;
}

static int h_export(int (*export_fn)(const char *name, const void *val, size_t len))
{
#define SAVE(k, field) export_fn("tracker/" k, &cfg.field, sizeof(cfg.field))

	SAVE("engine/rate_hz",  sample_rate_hz);
	SAVE("engine/sources",  data_sources);
	SAVE("disp/stat",       row_src);
	SAVE("disp/boxes",      box_src);
	SAVE("disp/timer_min",  timer_minutes);
	SAVE("lora/enabled",    lora.enabled);
	SAVE("lora/boat_id",    lora.boat_id);
	SAVE("lora/n_boats",    lora.n_boats);
	SAVE("lora/tx_rate_hz", lora.tx_rate_hz);
	SAVE("lora/frequency",  lora.frequency);
	SAVE("lora/tx_power",   lora.tx_power);
	SAVE("wind/twd",        true_wind_dir_deg);
	SAVE("cal/gyro_x",      gyro_bias_x_mdps);
	SAVE("cal/gyro_y",      gyro_bias_y_mdps);
	SAVE("cal/gyro_z",      gyro_bias_z_mdps);
	SAVE("cal/hard_iron",   hard_iron);
	SAVE("cal/soft_iron",   soft_iron);

#undef SAVE
	return 0;
}

SETTINGS_STATIC_HANDLER_DEFINE(tracker, "tracker", NULL, h_set, NULL, h_export);

/* ── Public API ──────────────────────────────────────────────────────────── */

int config_init(void)
{
	/* Start from defaults so missing NVS keys are covered. */
	cfg = cfg_defaults;

	int ret = settings_subsys_init();

	if (ret) {
		LOG_ERR("settings_subsys_init failed: %d", ret);
		return ret;
	}
	
	ret = settings_load();
	if (ret) {
		LOG_WRN("settings_load failed: %d — using defaults", ret);
	}

	LOG_INF("Config loaded (rate=%dHz lora=%s twd=%.1f)",
		cfg.sample_rate_hz,
		cfg.lora.enabled ? "on" : "off",
		(double)cfg.true_wind_dir_deg);

	return 0;
}

const struct app_config *config_get(void)
{
	return &cfg;
}

int config_save(void)
{
	int ret = settings_save();

	if (ret) {
		LOG_ERR("settings_save failed: %d", ret);
	} else {
		LOG_INF("Config saved");
	}
	return ret;
}

void config_set_sample_rate(data_rate_t hz)     { cfg.sample_rate_hz = hz; }
void config_set_data_sources(data_src_flags_t f){ cfg.data_sources = f; }
void config_set_row_src(row_src_t src)           { cfg.row_src = src; }
void config_set_timer_minutes(uint8_t min)       { cfg.timer_minutes = min; }

void config_set_box_src(int slot, box_src_t src)
{
	if (slot >= 0 && slot < BOX_COUNT) {
		cfg.box_src[slot] = src;
	}
}
void config_set_lora_enabled(bool en)           { cfg.lora.enabled = en; }
void config_set_lora_boat_id(uint8_t id)        { cfg.lora.boat_id = id; }
void config_set_lora_n_boats(uint8_t n)         { cfg.lora.n_boats = n; }
void config_set_lora_tx_rate(uint8_t hz)        { cfg.lora.tx_rate_hz = hz; }
void config_set_lora_frequency(uint32_t freq)   { cfg.lora.frequency = freq; }

void config_set_true_wind_dir(float deg)
{
	while (deg >= 360.0f) { deg -= 360.0f; }
	while (deg <    0.0f) { deg += 360.0f; }
	cfg.true_wind_dir_deg = deg;
}

void config_set_ahrs_gyro_bias(float x, float y, float z)
{
	cfg.gyro_bias_x_mdps = x;
	cfg.gyro_bias_y_mdps = y;
	cfg.gyro_bias_z_mdps = z;
}

void config_set_ahrs_mag_cal(const float hard[3], const float soft[3][3])
{
	for (int i = 0; i < 3; i++) {
		cfg.hard_iron[i] = hard[i];
		for (int j = 0; j < 3; j++) {
			cfg.soft_iron[i][j] = soft[i][j];
		}
	}
}
```

## src/config.h
```c
/*
 * config — Application configuration store
 *
 * Master config struct covering all subsystems. Persisted to NVS flash via
 * the Zephyr settings subsystem. Setters modify the live in-RAM struct;
 * call config_save() to persist to flash.
 *
 * SPDX-License-Identifier: Apache-2.0
 */

#ifndef CONFIG_H
#define CONFIG_H

#include <stdbool.h>
#include <stdint.h>
#include <zephyr/kernel.h>

/* ── Enums ───────────────────────────────────────────────────────────────── */

typedef enum {
	DATA_RATE_1HZ  = 1,
	DATA_RATE_2HZ  = 2,
	DATA_RATE_4HZ  = 4,
	DATA_RATE_5HZ  = 5,
	DATA_RATE_10HZ = 10,
} data_rate_t;

typedef enum {
	DATA_SRC_GPS  = BIT(0),
	DATA_SRC_AHRS = BIT(1),
} data_src_flags_t;

typedef enum {
	ROW_SRC_HEADING_DEG = 0,
	ROW_SRC_SPEED_KT,
	ROW_SRC_ALTITUDE_M,
	ROW_SRC_ROLL_DEG,
	ROW_SRC_PITCH_DEG,
	ROW_SRC_DRIFT_DEG,
	ROW_SRC_COUNT,
} row_src_t;

/* Content of one box in the 2×2 data-screen grid. */
typedef enum {
	BOX_SRC_SPEED = 0,   /* SOG in knots                */
	BOX_SRC_COG,         /* course over ground, degrees */
	BOX_SRC_SOG,         /* speed over ground, knots    */
	BOX_SRC_ROLL,        /* roll, degrees               */
	BOX_SRC_PITCH,       /* pitch, degrees              */
	BOX_SRC_GPS_TIME,    /* GPS UTC time, HH:MM         */
	BOX_SRC_HEADING,     /* compass bearing, degrees    */
	BOX_SRC_TIMER,       /* race countdown/up timer     */
	BOX_SRC_COUNT,
} box_src_t;

#define BOX_COUNT 4   /* 2×2 grid */

/* ── Config structs ──────────────────────────────────────────────────────── */

struct lora_cfg {
	bool     enabled;
	uint8_t  boat_id;    /* 0–3 */
	uint8_t  n_boats;    /* 1–4 */
	uint8_t  tx_rate_hz; /* 1–5 */
	uint32_t frequency;  /* Hz */
	int8_t   tx_power;   /* dBm */
};

struct app_config {
	/* Data engine */
	data_rate_t      sample_rate_hz;
	data_src_flags_t data_sources;

	/* Display */
	row_src_t        row_src;
	box_src_t        box_src[BOX_COUNT]; /* 2×2 grid contents */
	uint8_t          timer_minutes;      /* race timer countdown: 1/3/5 */

	/* LoRa */
	struct lora_cfg  lora;

	/* Wind */
	float            true_wind_dir_deg; /* direction wind comes FROM, 0–360 */

	/* AHRS calibration */
	float gyro_bias_x_mdps;
	float gyro_bias_y_mdps;
	float gyro_bias_z_mdps;
	float hard_iron[3];
	float soft_iron[3][3];
};

/* ── Public API ──────────────────────────────────────────────────────────── */

/**
 * Initialise the settings subsystem and load config from NVS.
 * Applies built-in defaults for any keys that are missing.
 * Must be called before config_get() or any setter.
 */
int config_init(void);

/** Return a const pointer to the live config struct. No locking required
 *  for reads — all writes come from the single display thread. */
const struct app_config *config_get(void);

/** Persist the current in-RAM config to NVS flash. */
int config_save(void);

/* Setters — modify live config; call config_save() to persist. */
void config_set_sample_rate(data_rate_t hz);
void config_set_data_sources(data_src_flags_t flags);
void config_set_row_src(row_src_t src);
void config_set_box_src(int slot, box_src_t src);
void config_set_timer_minutes(uint8_t min);
void config_set_lora_enabled(bool enabled);
void config_set_lora_boat_id(uint8_t id);
void config_set_lora_n_boats(uint8_t n);
void config_set_lora_tx_rate(uint8_t hz);
void config_set_lora_frequency(uint32_t freq_hz);
void config_set_true_wind_dir(float deg);
void config_set_ahrs_gyro_bias(float x, float y, float z);
void config_set_ahrs_mag_cal(const float hard[3], const float soft[3][3]);

#endif /* CONFIG_H */
```

## src/data_engine.c
```c
/*
 * data_engine — Sensor polling and ring-buffer averager
 *
 * SPDX-License-Identifier: Apache-2.0
 */

#include "data_engine.h"
#include "config.h"

#include <ahrs.h>
#include <zephyr/kernel.h>
#include <zephyr/logging/log.h>
#include <zephyr/drivers/gnss.h>
#include <string.h>

LOG_MODULE_REGISTER(data_engine, LOG_LEVEL_INF);

/* ── Ring buffer ─────────────────────────────────────────────────────────── */

/* 60 s × 10 Hz = 600 samples maximum. */
#define RING_SIZE  600

static struct data_sample ring[RING_SIZE];
static uint32_t ring_head;   /* next write index */
static uint32_t ring_count;  /* valid samples, capped at RING_SIZE */

/* ── Pending GPS slot (spinlock-protected) ───────────────────────────────── */

static struct k_spinlock gps_lock;
static struct gnss_data pending_gps;
static bool             pending_gps_valid;

/* ── Shared averages (mutex-protected) ──────────────────────────────────── */

static K_MUTEX_DEFINE(avg_mutex);
static struct data_averages shared_avg;
static struct data_sample   latest_sample;

/* Most recent GPS values, carried forward between fixes (engine thread only).
 * GPS arrives at ~1 Hz but samples capture at up to 10 Hz, so without this the
 * 9/10 samples between fixes would read zero. */
static struct gnss_time last_gps_utc;
static uint32_t last_gps_speed_mm_s;
static uint32_t last_gps_bearing_mdeg;
static int32_t  last_gps_altitude_mm;
static int64_t  last_gps_lat_ndeg;
static int64_t  last_gps_lon_ndeg;
static bool     last_gps_fix_valid;

/* ── Semaphore to signal data_processor ─────────────────────────────────── */

K_SEM_DEFINE(data_engine_sem, 0, 1);

/* ── Calibration flag (atomic for cross-thread access) ─────────────────── */

static volatile bool cal_active;
static volatile bool imu_cal_active;

/* ── GNSS callback ───────────────────────────────────────────────────────── */

static void gnss_data_cb(const struct device *dev, const struct gnss_data *data)
{
	ARG_UNUSED(dev);
	k_spinlock_key_t key = k_spin_lock(&gps_lock);

	pending_gps       = *data;
	pending_gps_valid = true;
	k_spin_unlock(&gps_lock, key);
}

GNSS_DATA_CALLBACK_DEFINE(DEVICE_DT_GET(DT_NODELABEL(gnss)), gnss_data_cb);

/* ── Average computation ─────────────────────────────────────────────────── */

static void recompute_averages(const struct app_config *cfg)
{
	uint32_t window = (uint32_t)cfg->sample_rate_hz * 60U;

	if (window > ring_count) {
		window = ring_count;
	}
	if (window == 0) {
		return;
	}

	uint64_t sum_speed = 0;
	uint64_t sum_bearing = 0;
	int64_t  sum_alt = 0;
	double   sum_hdg = 0.0, sum_roll = 0.0, sum_pitch = 0.0;
	uint32_t gps_count = 0;

	for (uint32_t i = 0; i < window; i++) {
		uint32_t idx = (ring_head + RING_SIZE - 1 - i) % RING_SIZE;
		const struct data_sample *s = &ring[idx];

		sum_hdg   += s->heading_deg;
		sum_roll  += s->roll_deg;
		sum_pitch += s->pitch_deg;

		if (s->gps_fix_valid) {
			sum_speed   += s->gps_speed_mm_s;
			sum_bearing += s->gps_bearing_mdeg;
			sum_alt     += s->gps_altitude_mm;
			gps_count++;
		}
	}

	struct data_averages avg = { 0 };

	avg.avg_heading_deg = (float)(sum_hdg  / window);
	avg.avg_roll_deg    = (float)(sum_roll / window);
	avg.avg_pitch_deg   = (float)(sum_pitch / window);

	if (gps_count > 0) {
		avg.avg_speed_mm_s   = (uint32_t)(sum_speed / gps_count);
		avg.avg_bearing_mdeg = (uint32_t)(sum_bearing / gps_count);
		avg.avg_altitude_mm  = (int32_t)(sum_alt / (int64_t)gps_count);
		avg.gps_fix_valid    = true;
	}

	/* Copy last-known position and UTC from the ring head. */
	if (ring_count > 0) {
		uint32_t last = (ring_head + RING_SIZE - 1) % RING_SIZE;

		avg.last_lat_ndeg = ring[last].gps_lat_ndeg;
		avg.last_lon_ndeg = ring[last].gps_lon_ndeg;
		avg.utc           = last_gps_utc;
	}

	k_mutex_lock(&avg_mutex, K_FOREVER);
	shared_avg = avg;
	k_mutex_unlock(&avg_mutex);
}

/* ── Engine thread ───────────────────────────────────────────────────────── */

#define ENGINE_STACK_SIZE  2048
#define ENGINE_PRIORITY    5

static K_THREAD_STACK_DEFINE(engine_stack, ENGINE_STACK_SIZE);
static struct k_thread engine_thread_data;

/* AHRS runs at 10 Hz internally regardless of capture rate. */
#define AHRS_INTERVAL_MS  100

static void engine_thread(void *p1, void *p2, void *p3)
{
	ARG_UNUSED(p1); ARG_UNUSED(p2); ARG_UNUSED(p3);

	int64_t  last_capture_ms = k_uptime_get();
	int64_t  last_ahrs_ms    = last_capture_ms;

	LOG_INF("Data engine started");

	while (1) {
		k_msleep(10); /* 10 ms base tick */

		const struct app_config *cfg = config_get();
		int64_t now = k_uptime_get();

		/* Run AHRS filter at 10 Hz regardless of capture rate. */
		if ((cfg->data_sources & DATA_SRC_AHRS) &&
		    (now - last_ahrs_ms) >= AHRS_INTERVAL_MS) {
			ahrs_update();

			/* Feed raw mag into calibration buffer when active. */
			if (cal_active) {
				ahrs_cal_collect();
			}

			if (imu_cal_active) {
				ahrs_imu_cal_collect();
			}

			last_ahrs_ms = now;
		}

		/* Capture sample at user-configured rate. */
		int64_t capture_interval_ms = 1000 / cfg->sample_rate_hz;

		if ((now - last_capture_ms) < capture_interval_ms) {
			continue;
		}
		last_capture_ms = now;

		struct data_sample s = { 0 };

		s.timestamp_ms = now;
		s.sources      = cfg->data_sources;

		/* Drain pending GPS slot. */
		k_spinlock_key_t key = k_spin_lock(&gps_lock);

		if (pending_gps_valid) {
			last_gps_speed_mm_s   = pending_gps.nav_data.speed;
			last_gps_bearing_mdeg = pending_gps.nav_data.bearing;
			last_gps_altitude_mm  = pending_gps.nav_data.altitude;
			last_gps_lat_ndeg     = pending_gps.nav_data.latitude;
			last_gps_lon_ndeg     = pending_gps.nav_data.longitude;
			last_gps_fix_valid    =
				(pending_gps.info.fix_status != GNSS_FIX_STATUS_NO_FIX);
			last_gps_utc          = pending_gps.utc;
			pending_gps_valid     = false;
		}
		k_spin_unlock(&gps_lock, key);

		/* Carry the most recent GPS values forward into every sample. */
		s.gps_speed_mm_s   = last_gps_speed_mm_s;
		s.gps_bearing_mdeg = last_gps_bearing_mdeg;
		s.gps_altitude_mm  = last_gps_altitude_mm;
		s.gps_lat_ndeg     = last_gps_lat_ndeg;
		s.gps_lon_ndeg     = last_gps_lon_ndeg;
		s.gps_fix_valid    = last_gps_fix_valid;

		/* Read AHRS. */
		if (cfg->data_sources & DATA_SRC_AHRS) {
			ahrs_get(&s.roll_deg, &s.pitch_deg, &s.heading_deg);
		}

		/* Write to ring. */
		ring[ring_head] = s;
		ring_head = (ring_head + 1) % RING_SIZE;
		if (ring_count < RING_SIZE) {
			ring_count++;
		}

		/* Update shared latest and averages. */
		k_mutex_lock(&avg_mutex, K_FOREVER);
		latest_sample = s;
		k_mutex_unlock(&avg_mutex);

		recompute_averages(cfg);

		/* Signal data_processor. */
		k_sem_give(&data_engine_sem);
	}
}

/* ── Public API ──────────────────────────────────────────────────────────── */

int data_engine_init(void)
{
	memset(ring, 0, sizeof(ring));
	ring_head  = 0;
	ring_count = 0;

	k_thread_create(&engine_thread_data, engine_stack,
			K_THREAD_STACK_SIZEOF(engine_stack),
			engine_thread, NULL, NULL, NULL,
			ENGINE_PRIORITY, 0, K_NO_WAIT);
	k_thread_name_set(&engine_thread_data, "data_engine");

	return 0;
}

void data_engine_push_gps(const struct gnss_data *data)
{
	/* Called from GNSS workqueue — use spinlock, not mutex. */
	k_spinlock_key_t key = k_spin_lock(&gps_lock);

	pending_gps       = *data;
	pending_gps_valid = true;
	k_spin_unlock(&gps_lock, key);
}

void data_engine_get_averages(struct data_averages *out)
{
	k_mutex_lock(&avg_mutex, K_FOREVER);
	*out = shared_avg;
	k_mutex_unlock(&avg_mutex);
}

void data_engine_get_latest(struct data_sample *out)
{
	k_mutex_lock(&avg_mutex, K_FOREVER);
	*out = latest_sample;
	k_mutex_unlock(&avg_mutex);
}

void data_engine_set_calibrating(bool cal)
{
	cal_active = cal;
}

bool data_engine_is_calibrating(void)
{
	return cal_active;
}

void data_engine_set_imu_calibrating(bool cal)
{
	imu_cal_active = cal;
}

bool data_engine_is_imu_calibrating(void)
{
	return imu_cal_active;
}
```

## src/data_engine.h
```c
/*
 * data_engine — Sensor polling and ring-buffer averager
 *
 * Owns a 600-entry ring buffer (60 s × 10 Hz max) of raw sensor samples.
 * Runs in its own thread; signals data_processor after each capture.
 *
 * SPDX-License-Identifier: Apache-2.0
 */

#ifndef DATA_ENGINE_H
#define DATA_ENGINE_H

#include <stdbool.h>
#include <stdint.h>
#include <zephyr/drivers/gnss.h>

/* ── Structs ─────────────────────────────────────────────────────────────── */

struct data_sample {
	int64_t  timestamp_ms;

	/* GPS fields */
	uint32_t gps_speed_mm_s;
	uint32_t gps_bearing_mdeg;
	int32_t  gps_altitude_mm;
	int64_t  gps_lat_ndeg;
	int64_t  gps_lon_ndeg;
	bool     gps_fix_valid;

	/* AHRS fields */
	float    heading_deg;
	float    roll_deg;
	float    pitch_deg;

	uint8_t  sources; /* data_src_flags_t bitmask */
};

struct data_averages {
	uint32_t avg_speed_mm_s;
	uint32_t avg_bearing_mdeg;
	int32_t  avg_altitude_mm;
	float    avg_heading_deg;
	float    avg_roll_deg;
	float    avg_pitch_deg;
	bool     gps_fix_valid;
	int64_t  last_lat_ndeg;
	int64_t  last_lon_ndeg;
	struct gnss_time utc; /* most recent GPS UTC time */
};

/* ── Public API ──────────────────────────────────────────────────────────── */

/**
 * Initialise the data engine and spawn its thread.
 * ahrs_init() must have been called before this.
 *
 * @return 0 on success, negative errno on failure.
 */
int data_engine_init(void);

/**
 * Called from the GNSS data callback to deliver a new GPS fix.
 * Thread-safe (uses spinlock internally).
 */
void data_engine_push_gps(const struct gnss_data *data);

/**
 * Get a consistent snapshot of the running averages.
 * Thread-safe; may be called from any thread.
 */
void data_engine_get_averages(struct data_averages *out);

/**
 * Get the most recently captured raw sample.
 * Thread-safe; may be called from any thread.
 */
void data_engine_get_latest(struct data_sample *out);

/**
 * Enable or disable magnetometer calibration collection.
 *
 * While enabled, the engine thread reads the raw magnetometer at
 * 10 Hz and feeds samples into the AHRS calibration buffer via
 * ahrs_cal_collect().  The normal AHRS filter continues running.
 *
 * Thread-safe; may be called from any thread.
 */
void data_engine_set_calibrating(bool cal);

/** Return true if calibration collection is active. */
bool data_engine_is_calibrating(void);

void data_engine_set_imu_calibrating(bool cal);
bool data_engine_is_imu_calibrating(void);

#endif /* DATA_ENGINE_H */
```

## src/data_processor.c
```c
/*
 * data_processor — Navigation algorithm runner
 *
 * SPDX-License-Identifier: Apache-2.0
 */

#include "data_processor.h"
#include "data_engine.h"
#include "lora_comms.h"
#include "config.h"

#include <nav.h>
#include <zephyr/kernel.h>
#include <zephyr/logging/log.h>
#include <string.h>

LOG_MODULE_REGISTER(data_processor, LOG_LEVEL_INF);

/* ── Peer packet queue (from lora RX thread) ─────────────────────────────── */

#define PEER_QUEUE_DEPTH  8

K_MSGQ_DEFINE(peer_msgq, sizeof(struct boat_packet), PEER_QUEUE_DEPTH, 4);

/* ── Shared results ──────────────────────────────────────────────────────── */

static K_MUTEX_DEFINE(results_mutex);
static struct nav_results shared_results;

/* ── Semaphore declared in data_engine.c ────────────────────────────────── */

extern struct k_sem data_engine_sem;

/* ── Processor thread ────────────────────────────────────────────────────── */

#define PROC_STACK_SIZE  2048
#define PROC_PRIORITY    6

static K_THREAD_STACK_DEFINE(proc_stack, PROC_STACK_SIZE);
static struct k_thread proc_thread_data;

static void processor_thread(void *p1, void *p2, void *p3)
{
	ARG_UNUSED(p1); ARG_UNUSED(p2); ARG_UNUSED(p3);

	int64_t last_update_ms = k_uptime_get();

	LOG_INF("Data processor started");

	while (1) {
		/* Wait for the data engine to produce a new sample. */
		k_sem_take(&data_engine_sem, K_FOREVER);

		const struct app_config *cfg = config_get();
		struct data_averages avg;

		data_engine_get_averages(&avg);

		int64_t now = k_uptime_get();
		uint32_t dt_ms = (uint32_t)(now - last_update_ms);

		last_update_ms = now;

		/* Run nav algorithms. */
		nav_update(avg.avg_speed_mm_s,
			   (uint32_t)(avg.avg_heading_deg * 1000.0f),
			   avg.avg_bearing_mdeg,
			   cfg->true_wind_dir_deg,
			   dt_ms);

		/* Build result. */
		struct nav_results r = { 0 };

		r.drift_deg     = nav_get_drift_deg();
		r.tack_detected = nav_tack_detected();
		r.gybe_detected = nav_gybe_detected();
		r.valid         = true;

		/* VMG differentials — drain peer queue. */
		struct boat_packet pkt;

		while (k_msgq_get(&peer_msgq, &pkt, K_NO_WAIT) == 0) {
			if (pkt.boat_id < 4) {
				uint32_t peer_speed_mm_s =
					(uint32_t)pkt.speed_ckt * 100000U / 1944U;
				uint32_t peer_bearing_cdeg = pkt.bearing_cdeg;
				uint32_t my_vmg = nav_compute_vmg(
					avg.avg_speed_mm_s,
					(uint32_t)(avg.avg_heading_deg * 1000.0f),
					cfg->true_wind_dir_deg);
				uint32_t peer_vmg = nav_compute_vmg(
					peer_speed_mm_s,
					peer_bearing_cdeg * 10U, /* cdeg → mdeg */
					cfg->true_wind_dir_deg);

				r.vmg_differential[pkt.boat_id] =
					nav_get_differential(my_vmg, peer_vmg);
			}
		}

		if (r.tack_detected) {
			LOG_INF("Tack detected!");
		}
		if (r.gybe_detected) {
			LOG_INF("Gybe detected!");
		}

		k_mutex_lock(&results_mutex, K_FOREVER);
		shared_results = r;
		k_mutex_unlock(&results_mutex);
	}
}

/* ── Public API ──────────────────────────────────────────────────────────── */

int data_processor_init(void)
{
	k_thread_create(&proc_thread_data, proc_stack,
			K_THREAD_STACK_SIZEOF(proc_stack),
			processor_thread, NULL, NULL, NULL,
			PROC_PRIORITY, 0, K_NO_WAIT);
	k_thread_name_set(&proc_thread_data, "data_proc");

	return 0;
}

void data_processor_get_results(struct nav_results *out)
{
	k_mutex_lock(&results_mutex, K_FOREVER);
	*out = shared_results;
	k_mutex_unlock(&results_mutex);
}

void data_processor_push_peer(const struct boat_packet *pkt)
{
	/* Non-blocking; drops if full. */
	k_msgq_put(&peer_msgq, pkt, K_NO_WAIT);
}
```

## src/data_processor.h
```c
/*
 * data_processor — Navigation algorithm runner
 *
 * Consumes data engine averages and peer LoRa packets; runs the nav library
 * to compute drift, tack/gybe events, and VMG differentials.
 *
 * SPDX-License-Identifier: Apache-2.0
 */

#ifndef DATA_PROCESSOR_H
#define DATA_PROCESSOR_H

#include <stdbool.h>
#include <stdint.h>

/* Forward declaration — full definition in lora_comms.h */
struct boat_packet;

/* ── Result struct ───────────────────────────────────────────────────────── */

struct nav_results {
	float   drift_deg;         /* leeway angle, positive = set to starboard */
	bool    tack_detected;     /* self-cleared after read                   */
	bool    gybe_detected;     /* self-cleared after read                   */
	int32_t vmg_differential[4]; /* signed mm/s vs each peer (index=boat_id) */
	bool    valid;
};

/* ── Public API ──────────────────────────────────────────────────────────── */

/**
 * Initialise and spawn the data processor thread.
 * data_engine_init() must have been called first.
 *
 * @return 0 on success, negative errno on failure.
 */
int data_processor_init(void);

/**
 * Get a consistent snapshot of the latest nav results.
 * Thread-safe.
 */
void data_processor_get_results(struct nav_results *out);

/**
 * Deliver a received peer packet from the LoRa RX thread.
 * Non-blocking (drops if the internal queue is full).
 */
void data_processor_push_peer(const struct boat_packet *pkt);

#endif /* DATA_PROCESSOR_H */
```

## src/display_engine.h
```c
/*
 * display_engine — Display rendering and button input
 *
 * Normal view: 3 configurable data rows.
 * Settings view: hierarchical menu.
 *
 * Button mapping:
 *   sw0 short-press (normal): no-op
 *   sw0 long-press  (normal): enter SETTINGS menu
 *   sw0 short-press (menu):   scroll to next item
 *   sw1 short-press (normal): capture current heading as True Wind Direction
 *   sw1 short-press (menu):   activate selected item
 *
 * SPDX-License-Identifier: Apache-2.0
 */

#ifndef DISPLAY_ENGINE_H
#define DISPLAY_ENGINE_H

/**
 * Initialise the display hardware, configure GPIO buttons, and spawn the
 * display thread.
 *
 * @return 0 on success, negative errno on failure.
 */
int display_engine_init(void);

#endif /* DISPLAY_ENGINE_H */
```

## src/lora_comms.c
```c
/*
 * lora_comms — Time-windowed LoRa multi-boat broadcast
 *
 * SPDX-License-Identifier: Apache-2.0
 */

#include "lora_comms.h"
#include "data_engine.h"
#include "data_processor.h"
#include "config.h"

#include <zephyr/kernel.h>
#include <zephyr/drivers/lora.h>
#include <zephyr/sys/crc.h>
#include <zephyr/logging/log.h>
#include <string.h>

LOG_MODULE_REGISTER(lora_comms, LOG_LEVEL_INF);

/* ── LoRa device ─────────────────────────────────────────────────────────── */

#define LORA_DEV  DEVICE_DT_GET(DT_ALIAS(lora0))

/* ── Pairing phase duration ──────────────────────────────────────────────── */

#define PAIRING_DURATION_MS  5000

typedef enum {
	PHASE_PAIRING = 0,
	PHASE_RUNNING,
} lora_phase_t;

/* ── Shared TX data (mutex-protected) ───────────────────────────────────── */

static K_MUTEX_DEFINE(tx_mutex);
static struct data_sample tx_sample;

/* ── Shared peer state (mutex-protected) ─────────────────────────────────── */

static K_MUTEX_DEFINE(peer_mutex);
static struct peer_boat peers[4];

/* ── RSSI of last received packet ────────────────────────────────────────── */

static int8_t last_rssi_rx;

/* ── CRC helper ──────────────────────────────────────────────────────────── */

static uint8_t pkt_crc(const struct boat_packet *pkt)
{
	/* CRC-8/MAXIM (poly 0x31, init 0x00) over bytes [0..22] */
	return crc8((const uint8_t *)pkt, 23, 0x31, 0x00, false);
}

/* ── Packet builder ──────────────────────────────────────────────────────── */

static void build_data_packet(struct boat_packet *pkt, const struct app_config *cfg,
			       const struct data_sample *s)
{
	memset(pkt, 0, sizeof(*pkt));

	pkt->type    = LORA_PKT_DATA;
	pkt->boat_id = cfg->lora.boat_id;
	pkt->n_boats = 0;

	/* Speed: mm/s → centi-knots */
	uint32_t speed_ckt = s->gps_speed_mm_s * 1944U / 100000U;

	pkt->speed_ckt    = (uint16_t)(speed_ckt > 0xFFFF ? 0xFFFF : speed_ckt);
	pkt->heading_cdeg = (uint16_t)((uint32_t)(s->heading_deg * 100.0f) % 36000U);
	pkt->bearing_cdeg = (uint16_t)(s->gps_bearing_mdeg / 10U);
	pkt->lat_100ndeg  = (int32_t)(s->gps_lat_ndeg / 100);
	pkt->lon_100ndeg  = (int32_t)(s->gps_lon_ndeg / 100);
	pkt->altitude_m   = (int16_t)(s->gps_altitude_mm / 1000);
	pkt->utc_min_ms   = 0; /* filled by TX thread from UTC time */
	pkt->rssi_rx      = last_rssi_rx;
	pkt->crc8         = pkt_crc(pkt);
}

static void build_hello_packet(struct boat_packet *pkt, const struct app_config *cfg)
{
	memset(pkt, 0, sizeof(*pkt));
	pkt->type    = LORA_PKT_HELLO;
	pkt->boat_id = cfg->lora.boat_id;
	pkt->n_boats = cfg->lora.n_boats;
	pkt->rssi_rx = last_rssi_rx;
	pkt->crc8    = pkt_crc(pkt);
}

/* ── RX thread ───────────────────────────────────────────────────────────── */

#define RX_STACK_SIZE  3072
#define RX_PRIORITY    3

static K_THREAD_STACK_DEFINE(rx_stack, RX_STACK_SIZE);
static struct k_thread rx_thread_data;

static void rx_thread(void *p1, void *p2, void *p3)
{
	ARG_UNUSED(p1); ARG_UNUSED(p2); ARG_UNUSED(p3);

	const struct device *lora_dev = LORA_DEV;
	uint8_t buf[sizeof(struct boat_packet)];
	int16_t rssi;
	int8_t  snr;

	LOG_INF("LoRa RX thread started");

	while (1) {
		int len = lora_recv(lora_dev, buf, sizeof(buf),
				    K_MSEC(500), &rssi, &snr);

		if (len < 0) {
			/* Timeout or error — loop. */
			continue;
		}
		if (len != sizeof(struct boat_packet)) {
			LOG_WRN("RX: unexpected packet length %d", len);
			continue;
		}

		struct boat_packet *pkt = (struct boat_packet *)buf;

		/* Verify CRC. */
		if (pkt->crc8 != pkt_crc(pkt)) {
			LOG_WRN("RX: CRC mismatch from boat %d", pkt->boat_id);
			continue;
		}
		if (pkt->boat_id >= 4) {
			continue;
		}

		last_rssi_rx = (int8_t)(rssi > 127 ? 127 : rssi);

		/* Update peer table. */
		k_mutex_lock(&peer_mutex, K_FOREVER);
		peers[pkt->boat_id].boat_id     = pkt->boat_id;
		peers[pkt->boat_id].seen        = true;
		peers[pkt->boat_id].last_rx_ms  = k_uptime_get();
		peers[pkt->boat_id].speed_ckt   = pkt->speed_ckt;
		peers[pkt->boat_id].bearing_cdeg= pkt->bearing_cdeg;
		peers[pkt->boat_id].last_rssi   = last_rssi_rx;
		k_mutex_unlock(&peer_mutex);

		/* Forward to data_processor. */
		data_processor_push_peer(pkt);

		LOG_DBG("RX boat=%d speed=%d rssi=%d", pkt->boat_id, pkt->speed_ckt, rssi);
	}
}

/* ── TX thread ───────────────────────────────────────────────────────────── */

#define TX_STACK_SIZE  2048
#define TX_PRIORITY    4

static K_THREAD_STACK_DEFINE(tx_stack, TX_STACK_SIZE);
static struct k_thread tx_thread_data;

static void tx_thread(void *p1, void *p2, void *p3)
{
	ARG_UNUSED(p1); ARG_UNUSED(p2); ARG_UNUSED(p3);

	const struct device *lora_dev = LORA_DEV;
	const struct app_config *cfg  = config_get();
	lora_phase_t phase            = PHASE_PAIRING;
	int64_t phase_start_ms        = k_uptime_get();
	uint8_t n_boats               = cfg->lora.n_boats;

	LOG_INF("LoRa TX thread started (pairing for %d ms)", PAIRING_DURATION_MS);

	while (1) {
		int64_t now = k_uptime_get();

		if (phase == PHASE_PAIRING) {
			/* Broadcast HELLO at 1 Hz during pairing. */
			struct boat_packet pkt;

			build_hello_packet(&pkt, cfg);
			lora_send(lora_dev, (uint8_t *)&pkt, sizeof(pkt));
			LOG_DBG("TX HELLO boat_id=%d", cfg->lora.boat_id);

			if ((now - phase_start_ms) >= PAIRING_DURATION_MS) {
				/* Determine n_boats from peers seen. */
				k_mutex_lock(&peer_mutex, K_FOREVER);
				for (int i = 3; i >= 0; i--) {
					if (peers[i].seen) {
						n_boats = MAX(n_boats, (uint8_t)(i + 1));
						break;
					}
				}
				k_mutex_unlock(&peer_mutex);

				LOG_INF("Pairing done: %d boat(s) on channel", n_boats);
				phase = PHASE_RUNNING;
			}

			k_msleep(1000);
			continue;
		}

		/* ── Running phase: GPS-aligned TX windows ─────────────────── */
		uint32_t tx_period_ms  = 1000U / cfg->lora.tx_rate_hz;
		uint32_t slot_width_ms = tx_period_ms / n_boats;
		uint32_t tx_offset_ms  = cfg->lora.boat_id * slot_width_ms;

		/* Get UTC milliseconds within current minute from averages. */
		struct data_averages avg;

		data_engine_get_averages(&avg);

		uint32_t utc_min_ms = 0;

		if (avg.gps_fix_valid) {
			utc_min_ms = (uint32_t)avg.utc.minute * 60000U
				     + (uint32_t)avg.utc.millisecond;
		}

		uint32_t now_in_period = utc_min_ms % tx_period_ms;
		uint32_t until_slot = (tx_period_ms + tx_offset_ms - now_in_period)
				       % tx_period_ms;

		if (until_slot > 0) {
			k_msleep(until_slot);
		}

		/* Build and send DATA packet. */
		struct data_sample s;

		k_mutex_lock(&tx_mutex, K_FOREVER);
		s = tx_sample;
		k_mutex_unlock(&tx_mutex);

		struct boat_packet pkt;

		build_data_packet(&pkt, cfg, &s);

		/* Fill UTC field. */
		pkt.utc_min_ms = (uint16_t)(utc_min_ms % 65536U);
		pkt.crc8       = pkt_crc(&pkt);

		int ret = lora_send(lora_dev, (uint8_t *)&pkt, sizeof(pkt));

		if (ret < 0) {
			LOG_WRN("TX failed: %d", ret);
		} else {
			LOG_DBG("TX DATA boat=%d spd=%d", cfg->lora.boat_id, pkt.speed_ckt);
		}

		/* Sleep for remainder of period. */
		k_msleep(tx_period_ms - slot_width_ms);
	}
}

/* ── Public API ──────────────────────────────────────────────────────────── */

int lora_comms_init(void)
{
	const struct device *lora_dev = LORA_DEV;
	const struct app_config *cfg  = config_get();

	if (!device_is_ready(lora_dev)) {
		LOG_ERR("LoRa device not ready");
		return -ENODEV;
	}

	/* Configure radio: SF7, BW125, 24-byte packets ~50 ms on-air. */
	struct lora_modem_config radio_cfg = {
		.frequency    = cfg->lora.frequency,
		.bandwidth    = BW_125_KHZ,
		.datarate     = SF_7,
		.coding_rate  = CR_4_5,
		.preamble_len = 8,
		.tx_power     = cfg->lora.tx_power,
		.tx           = true,
	};

	int ret = lora_config(lora_dev, &radio_cfg);

	if (ret < 0) {
		LOG_ERR("lora_config failed: %d", ret);
		return ret;
	}

	memset(peers, 0, sizeof(peers));

	k_thread_create(&rx_thread_data, rx_stack,
			K_THREAD_STACK_SIZEOF(rx_stack),
			rx_thread, NULL, NULL, NULL,
			RX_PRIORITY, 0, K_NO_WAIT);
	k_thread_name_set(&rx_thread_data, "lora_rx");

	k_thread_create(&tx_thread_data, tx_stack,
			K_THREAD_STACK_SIZEOF(tx_stack),
			tx_thread, NULL, NULL, NULL,
			TX_PRIORITY, 0, K_NO_WAIT);
	k_thread_name_set(&tx_thread_data, "lora_tx");

	return 0;
}

void lora_comms_set_tx_data(const struct data_sample *s)
{
	k_mutex_lock(&tx_mutex, K_FOREVER);
	memcpy(&tx_sample, s, sizeof(tx_sample));
	k_mutex_unlock(&tx_mutex);
}

int lora_comms_get_peers(struct peer_boat peers_out[4])
{
	int count = 0;

	k_mutex_lock(&peer_mutex, K_FOREVER);
	memcpy(peers_out, peers, sizeof(peers));
	for (int i = 0; i < 4; i++) {
		if (peers[i].seen) {
			count++;
		}
	}
	k_mutex_unlock(&peer_mutex);

	return count;
}
```

## src/lora_comms.h
```c
/*
 * lora_comms — Time-windowed LoRa multi-boat broadcast
 *
 * Up to 4 boats share one channel. GPS UTC time is used to divide the TX
 * period into per-boat slots. A 5 s pairing phase discovers how many boats
 * are on channel before entering the running phase.
 *
 * SPDX-License-Identifier: Apache-2.0
 */

#ifndef LORA_COMMS_H
#define LORA_COMMS_H

#include <stdbool.h>
#include <stdint.h>
#include <zephyr/kernel.h>
#include "data_engine.h"

/* ── Wire packet ─────────────────────────────────────────────────────────── */

/**
 * Fixed 24-byte packet transmitted by every boat.
 * All multi-byte fields are little-endian.
 */
struct __attribute__((packed)) boat_packet {
	uint8_t  type;         /* LORA_PKT_HELLO=0x01, LORA_PKT_DATA=0x02   */
	uint8_t  boat_id;      /* 0–3                                         */
	uint8_t  n_boats;      /* total boats on channel (HELLO only, 0=DATA) */
	uint8_t  reserved;     /* 0x00                                        */
	uint16_t speed_ckt;    /* centi-knots                                 */
	uint16_t heading_cdeg; /* centidegrees 0–35999                        */
	uint16_t bearing_cdeg; /* GPS COG centidegrees                        */
	int32_t  lat_100ndeg;  /* nanodegrees / 100                           */
	int32_t  lon_100ndeg;  /* nanodegrees / 100                           */
	int16_t  altitude_m;   /* metres                                      */
	uint16_t utc_min_ms;   /* (minute*60000 + ms) % 65536                 */
	int8_t   rssi_rx;      /* RSSI of last received packet, dBm           */
	uint8_t  crc8;         /* CRC-8/MAXIM over bytes [0..22]              */
};

BUILD_ASSERT(sizeof(struct boat_packet) == 24, "boat_packet must be 24 bytes");

#define LORA_PKT_HELLO 0x01
#define LORA_PKT_DATA  0x02

/* ── Per-peer state (public for data_processor) ──────────────────────────── */

struct peer_boat {
	uint8_t  boat_id;
	bool     seen;
	int64_t  last_rx_ms;
	uint16_t speed_ckt;
	uint16_t bearing_cdeg;
	int8_t   last_rssi;
};

/* ── Public API ──────────────────────────────────────────────────────────── */

/**
 * Initialise LoRa hardware and spawn RX + TX threads.
 * config_init() must have been called first.
 *
 * @return 0 on success, negative errno on failure.
 */
int lora_comms_init(void);

/**
 * Update the data to be included in the next TX packet.
 * Thread-safe; called by data_engine after each capture.
 */
void lora_comms_set_tx_data(const struct data_sample *s);

/**
 * Copy current peer state into @p peers_out[4].
 * Returns the number of peers seen during pairing / running.
 * Thread-safe.
 */
int lora_comms_get_peers(struct peer_boat peers_out[4]);

#endif /* LORA_COMMS_H */
```
